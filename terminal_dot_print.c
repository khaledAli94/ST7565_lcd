#include <stdio.h>
#include <stdint.h>

#define LCD_WIDTH 128
#define LCD_HEIGHT 64

uint8_t st7565_buffer[1024] = { 
};

#include <stdio.h>
#include <stdint.h>

const unsigned char fb[] = {
	0x00, 0x00, 0x00, 0x00, 0x00, 0x00, 0x00, 0x00, 0x00, 0x00, 0x00, 0x00, 0x00, 0x00, 0x00, 0x00, 
	0x00, 0x00, 0x00, 0x00, 0x00, 0x00, 0x00, 0x00, 0x00, 0x00, 0x00, 0x00, 0x00, 0x00, 0x00, 0x00, 
	0x00, 0x00, 0x00, 0x00, 0x00, 0x00, 0x00, 0x00, 0x00, 0x00, 0x00, 0x00, 0x00, 0x00, 0x00, 0x00, 
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	0x00, 0x00, 0x00, 0x00, 0x00, 0x00, 0x00, 0x00, 0x00, 0x00, 0x00, 0x00, 0x00, 0x00, 0x00, 0x00
    
};

    int WIDTH = 128;
    int HEIGHT = 64;
    
void framebuffer_to_page_major_rev(
    const uint8_t *src,
    uint8_t *dst
) {
    for (int page = 0; page < 8; page++) {

        int hw_page = 7 - page;   // <-- reverse page order

        for (int x = 0; x < 128; x++) {
            uint8_t byte = 0;

            for (int bit = 0; bit < 8; bit++) {
                int y = page * 8 + bit;
                int src_index = y * 128 + x;

                uint8_t pixel = (src[src_index / 8] >> (src_index % 8)) & 1;
                byte |= pixel << bit;
            }

            dst[hw_page * 128 + x] = byte;
        }
    }
}


void framebuffer_to_page_major(
    const uint8_t *src,   // 1024‑byte linear framebuffer
    uint8_t *dst          // 1024‑byte page‑major output
) {
    for (int page = 0; page < 8; page++) {
        for (int x = 0; x < 128; x++) {
            uint8_t byte = 0;

            for (int bit = 0; bit < 8; bit++) {
                int y = page * 8 + bit;
                int src_index = y * 128 + x;

                uint8_t pixel = (src[src_index / 8] >> (src_index % 8)) & 1;
                byte |= pixel << bit;
            }

            dst[page * 128 + x] = byte;
        }
    }
}

void dump_c_array(const uint8_t *buf, int size) {
    printf("const uint8_t image[%d] = {\n", size);
    for (int i = 0; i < size; i++) {
        if (i % 16 == 0) printf("    ");
        printf("0x%02X,", buf[i]);
        if (i % 16 == 15) printf("\n");
    }
    printf("};\n");
}

int main()
{
    uint8_t page_major[1024];
    framebuffer_to_page_major_rev(fb, page_major);
    dump_c_array(page_major, 1024);

    return 0;
}

void printBufferAsDots() {
    for (int y = 0; y < LCD_HEIGHT; y++) {
        int page = y / 8;
        int bit  = y % 8;

        for (int x = 0; x < LCD_WIDTH; x++) {
            uint8_t byte = st7565_buffer[page * LCD_WIDTH + x];
            if (byte & (1 << bit))
                printf("#");
            else
                printf(".");
        }
        printf("\n");
    }
}

void printlcdAsDots() {
    for (int y = 0; y < LCD_HEIGHT; y++) {
        int page = y / 8;
        int bit  = y % 8;

        // Apply LCD COM-scan reversal
        int lcd_page = 7 - page;

        for (int x = 0; x < LCD_WIDTH; x++) {
            uint8_t byte = st7565_buffer[lcd_page * LCD_WIDTH + x];

            if (byte & (1 << bit))
                printf("#");
            else
                printf(".");
        }
        printf("\n");
    }
}


int main() {
    // printBufferAsDots();
    printlcdAsDots();
    return 0;
}
